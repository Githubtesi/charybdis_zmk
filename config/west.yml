## config/west.yml
```yaml
manifest:
  remotes:
    - name: zmkfirmware
      url-base: https://github.com/zmkfirmware
    - name: badjeff
      url-base: https://github.com/badjeff
  projects:
    - name: zmk
      remote: zmkfirmware
      # v0.2より少し新しく、かつ安定している v0.3 ブランチを指定します
      revision: v0.3-branch
      import: app/west.yml
    - name: zmk-pmw3610-driver
      remote: badjeff
      # ハッシュ値をやめて、安定版用のブランチ名を指定します
      revision: zmk-0.3
    - name: zmk-split-peripheral-input-relay
      remote: badjeff
      revision: main
    - name: zmk-input-behavior-listener
      remote: badjeff
      revision: main
  self:
    path: config
```
